## firmware/esp32/main/Kconfig
```kconfig
config ESP_HOSTED_HOST_USB_CDC_ACM_MANIFEST
    int "ESP-Hosted USB CDC manifest gate"
    default 0

config ESP_HOSTED_HOST_USB_CHERRYUSB_MANIFEST
    int "ESP-Hosted CherryUSB manifest gate"
    default 0

config ESP_HOSTED_HOST_USB_RNDIS_MANIFEST
    int "ESP-Hosted USB RNDIS manifest gate"
    default 0
```

## firmware/esp32/main/Kconfig.projbuild
```kconfig
menu "Panel"

config PANEL_WIFI_SSID
    string "Wi-Fi network"
    default ""
    help
        Stored in the firmware image on the device. The Home Assistant token is not.

config PANEL_WIFI_PASSWORD
    string "Wi-Fi password"
    default ""

config PANEL_WIDTH
    int "Width in dp"
    default 720
    range 1 1920

config PANEL_HEIGHT
    int "Height in dp"
    default 720
    range 1 1920

endmenu
```

## firmware/esp32/sdkconfig.defaults
```kconfig
CONFIG_IDF_TARGET="esp32p4"
CONFIG_ESPTOOLPY_FLASHSIZE_32MB=y
CONFIG_ESPTOOLPY_FLASHSIZE="32MB"
CONFIG_PARTITION_TABLE_CUSTOM=y
CONFIG_PARTITION_TABLE_CUSTOM_FILENAME="partitions.csv"
CONFIG_COMPILER_OPTIMIZATION_SIZE=y
CONFIG_COMPILER_CXX_EXCEPTIONS=y
CONFIG_SPIRAM=y
CONFIG_FREERTOS_HZ=1000
CONFIG_ESP_MAIN_TASK_STACK_SIZE=12288
CONFIG_ESP_WIFI_REMOTE_ENABLED=y
CONFIG_ESP_WIFI_REMOTE_LIBRARY_HOSTED=y
CONFIG_SLAVE_IDF_TARGET_ESP32C6=y
CONFIG_ESP_HOSTED_ENABLED=y
CONFIG_ESP_HOSTED_CP_TARGET_ESP32C6=y
CONFIG_ESP_HOSTED_SDIO_HOST_INTERFACE=y
CONFIG_ESP_HOSTED_HOST_USB_CDC_ACM_MANIFEST=0
CONFIG_ESP_HOSTED_HOST_USB_CHERRYUSB_MANIFEST=0
CONFIG_ESP_HOSTED_HOST_USB_RNDIS_MANIFEST=0
```
